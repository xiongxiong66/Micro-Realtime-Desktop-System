/**
  ******************************************************************************
  * @file           : oled.c
  * @brief          : SSD1306 OLED driver (128x64, I2C)
  ******************************************************************************
  */

#include "oled.h"
#include "i2c.h"

/* Control bytes */
#define OLED_CTRL_CMD   0x00U
#define OLED_CTRL_DATA  0x40U

/* Commands */
#define OLED_CMD_DISPLAY_OFF      0xAEU
#define OLED_CMD_DISPLAY_ON       0xAFU
#define OLED_CMD_SET_CONTRAST     0x81U
#define OLED_CMD_SET_NORM_DISP    0xA6U
#define OLED_CMD_SET_INVERT_DISP  0xA7U
#define OLED_CMD_SET_MUX          0xA8U
#define OLED_CMD_SET_DISPLAY_OFFSET 0xD3U
#define OLED_CMD_SET_START_LINE   0x40U
#define OLED_CMD_SET_SEG_REMAP    0xA0U
#define OLED_CMD_SET_COM_SCAN_DIR 0xC0U
#define OLED_CMD_SET_COM_PINS     0xDAU
#define OLED_CMD_SET_CLK_DIV      0xD5U
#define OLED_CMD_SET_PRECHARGE    0xD9U
#define OLED_CMD_SET_VCOM_DESELECT 0xDBU
#define OLED_CMD_CHARGE_PUMP      0x8DU
#define OLED_CMD_MEM_ADDR_MODE    0x20U
#define OLED_CMD_COL_ADDR         0x21U
#define OLED_CMD_PAGE_ADDR        0x22U

static uint8_t frame_buffer[OLED_BUFFER_SIZE];
static uint8_t cursor_x = 0;
static uint8_t cursor_y = 0;

/* 5x7 Font (ASCII 32-127) */
static const uint8_t font_5x7[][5] = {
    {0x00,0x00,0x00,0x00,0x00},{0x00,0x00,0x5F,0x00,0x00},{0x00,0x07,0x00,0x07,0x00},
    {0x14,0x7F,0x14,0x7F,0x14},{0x24,0x2A,0x7F,0x2A,0x12},{0x23,0x13,0x08,0x64,0x62},
    {0x36,0x49,0x55,0x22,0x50},{0x00,0x05,0x03,0x00,0x00},{0x00,0x1C,0x22,0x41,0x00},
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    {0x00,0x41,0x36,0x08,0x00},{0x08,0x08,0x2A,0x1C,0x08},{0x00,0x00,0x00,0x00,0x00}
};

static BSP_I2C_Status_t OLED_WriteCmd(uint8_t cmd) {
    return BSP_I2C_Mem_Write(OLED_I2C_ADDR, OLED_CTRL_CMD, I2C_MEMADD_SIZE_8BIT, &cmd, 1);
}
static BSP_I2C_Status_t OLED_WriteCmdMulti(const uint8_t *c, uint16_t l) {
    return BSP_I2C_Mem_Write(OLED_I2C_ADDR, OLED_CTRL_CMD, I2C_MEMADD_SIZE_8BIT, (uint8_t*)c, l);
}
static BSP_I2C_Status_t OLED_WriteData(const uint8_t *d, uint16_t l) {
    return BSP_I2C_Mem_Write(OLED_I2C_ADDR, OLED_CTRL_DATA, I2C_MEMADD_SIZE_8BIT, (uint8_t*)d, l);
}
static void OLED_SetWindow(uint8_t cs, uint8_t ps, uint8_t ce, uint8_t pe) {
    uint8_t c[] = {OLED_CMD_COL_ADDR, cs & 0x7F, ce & 0x7F, OLED_CMD_PAGE_ADDR, ps & 7, pe & 7};
    OLED_WriteCmdMulti(c, sizeof(c));
}

BSP_I2C_Status_t OLED_Init(void) {
    const uint8_t init[] = {
        OLED_CMD_DISPLAY_OFF, OLED_CMD_SET_CLK_DIV, 0x80, OLED_CMD_SET_MUX, 0x3F,
        OLED_CMD_SET_DISPLAY_OFFSET, 0x00, OLED_CMD_SET_START_LINE,
        OLED_CMD_CHARGE_PUMP, 0x14, OLED_CMD_MEM_ADDR_MODE, 0x00,
        OLED_CMD_SET_SEG_REMAP | 1, OLED_CMD_SET_COM_SCAN_DIR | 8,
        OLED_CMD_SET_COM_PINS, 0x12, OLED_CMD_SET_CONTRAST, 0x7F,
        OLED_CMD_SET_PRECHARGE, 0xF1, OLED_CMD_SET_VCOM_DESELECT, 0x40,
        OLED_CMD_SET_NORM_DISP, OLED_CMD_DISPLAY_ON
    };
    BSP_I2C_Status_t r = OLED_WriteCmdMulti(init, sizeof(init));
    if (r == BSP_I2C_OK) { OLED_Clear(); OLED_Display(); }
    return r;
}
void OLED_Display(void) {
    OLED_SetWindow(0, 0, OLED_WIDTH - 1, OLED_PAGES - 1);
    OLED_WriteData(frame_buffer, OLED_BUFFER_SIZE);
}
void OLED_Clear(void) { memset(frame_buffer, 0, OLED_BUFFER_SIZE); cursor_x = 0; cursor_y = 0; }
void OLED_Fill(void) { memset(frame_buffer, 0xFF, OLED_BUFFER_SIZE); }

void OLED_DrawPixel(uint8_t x, uint8_t y, uint8_t color) {
    if (x >= OLED_WIDTH || y >= OLED_HEIGHT) return;
    uint16_t idx = (uint16_t)(y / 8) * OLED_WIDTH + x;
    if (color) frame_buffer[idx] |= (uint8_t)(1 << (y % 8));
    else frame_buffer[idx] &= (uint8_t)~(1 << (y % 8));
}
void OLED_SetCursor(uint8_t x, uint8_t y) {
    cursor_x = (x < OLED_WIDTH) ? x : (OLED_WIDTH - 1);
    cursor_y = (y < OLED_HEIGHT) ? y : (OLED_HEIGHT - 1);
}
void OLED_PrintChar(char ch) {
    if (ch < 0x20 || ch > 0x7E) ch = ' ';
    uint8_t idx = (uint8_t)(ch - 0x20);
    if (cursor_x + 6 > OLED_WIDTH) { cursor_x = 0; cursor_y += 8; }
    if (cursor_y + 8 > OLED_HEIGHT) { cursor_x = 0; cursor_y = 0; }
    for (uint8_t col = 0; col < 5; col++) {
        uint8_t line = font_5x7[idx][col];
        for (uint8_t row = 0; row < 8; row++)
            OLED_DrawPixel(cursor_x + col, cursor_y + row, (line & (1 << row)) ? OLED_WHITE : OLED_BLACK);
    }
    for (uint8_t row = 0; row < 8; row++) OLED_DrawPixel(cursor_x + 5, cursor_y + row, OLED_BLACK);
    cursor_x += 6;
}
void OLED_PrintString(const char *str) {
    if (!str) return;
    while (*str) {
        if (*str == '\n') { cursor_x = 0; cursor_y += 8; str++; continue; }
        if (*str == '\r') { cursor_x = 0; str++; continue; }
        OLED_PrintChar(*str++);
    }
}
void OLED_PrintNum(uint32_t num, uint8_t base) {
    char buf[12]; uint8_t i = 0;
    if (num == 0) { OLED_PrintChar('0'); return; }
    while (num && i < sizeof(buf) - 1) {
        uint8_t d = (uint8_t)(num % base);
        buf[i++] = (d < 10) ? ('0' + d) : ('A' + d - 10);
        num /= base;
    }
    while (i) OLED_PrintChar(buf[--i]);
}
void OLED_PrintSignedNum(int32_t num, uint8_t base) {
    if (num < 0) { OLED_PrintChar('-'); OLED_PrintNum((uint32_t)(-num), base); }
    else OLED_PrintNum((uint32_t)num, base);
}
void OLED_On(void) { OLED_WriteCmd(OLED_CMD_DISPLAY_ON); }
void OLED_Off(void) { OLED_WriteCmd(OLED_CMD_DISPLAY_OFF); }
void OLED_Invert(uint8_t e) { OLED_WriteCmd(e ? OLED_CMD_SET_INVERT_DISP : OLED_CMD_SET_NORM_DISP); }
